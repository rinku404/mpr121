## Kconfig
```kconfig
menu "MPR121 Touch Sensor"

    config MPR121_I2C_TIMEOUT_MS
        int "I2C command timeout in milliseconds"
        default 1000
        help
            Timeout for I2C master command in milliseconds.
endmenu
```
